## Config.in
```kconfig
menu "Bianbu config"

config BR2_TARGET_K3_ROOTFS_OVERLAY
	bool "Enable the K3 rootfs overlay"
	help
	  Mount the root filesystem read-only and use the userdata
	  partition as the persistent OverlayFS upper layer. This also
	  enables the misc partition used to request a userdata reset.
	  When disabled, rootfs is the final partition and uses the
	  remaining block device space.

config BR2_TARGET_K3_BOOTFS_MODULES
	bool "Install Linux kernel modules in bootfs"
	depends on BR2_LINUX_KERNEL
	help
	  Install Linux kernel modules under /lib/modules in the bootfs
	  image instead of the target root filesystem. The initramfs mounts
	  bootfs at /boot and bind mounts /boot/lib/modules/<release> at
	  /lib/modules/<release> for the running kernel.

config BR2_TARGET_K3_BOOTFS_SIZE
	int "Bootfs partition size (MiB)"
	default 256
	range 1 4096
	help
	  Size of the bootfs partition and ext4 image in MiB. Partition
	  offsets after bootfs are adjusted to match this value.

source "$BR2_EXTERNAL_Bianbu_PATH/package/rtk-hciattach/Config.in"
source "$BR2_EXTERNAL_Bianbu_PATH/package/mpp/Config.in"
source "$BR2_EXTERNAL_Bianbu_PATH/package/img-gpu-powervr/Config.in"
source "$BR2_EXTERNAL_Bianbu_PATH/package/drm-test/Config.in"
source "$BR2_EXTERNAL_Bianbu_PATH/package/v2d-test/Config.in"
source "$BR2_EXTERNAL_Bianbu_PATH/package/k3x-vpu-test/Config.in"
source "$BR2_EXTERNAL_Bianbu_PATH/package/gpu-test/Config.in"
source "$BR2_EXTERNAL_Bianbu_PATH/package/k3x-vpu-firmware/Config.in"
source "$BR2_EXTERNAL_Bianbu_PATH/package/k3x-cam/Config.in"
source "$BR2_EXTERNAL_Bianbu_PATH/package/vk-gl-cts/Config.in"
source "$BR2_EXTERNAL_Bianbu_PATH/package/onnx-runtime/Config.in"
source "$BR2_EXTERNAL_Bianbu_PATH/package/ai-support/Config.in"
source "$BR2_EXTERNAL_Bianbu_PATH/package/usb-gadget/Config.in"

source "$BR2_EXTERNAL_Bianbu_PATH/package/factorytest/Config.in"
source "$BR2_EXTERNAL_Bianbu_PATH/package/jetson-utils/Config.in"
source "$BR2_EXTERNAL_Bianbu_PATH/package/lvgl/Config.in"
source "$BR2_EXTERNAL_Bianbu_PATH/package/jdk/Config.in"
source "$BR2_EXTERNAL_Bianbu_PATH/package/esos/Config.in"
source "$BR2_EXTERNAL_Bianbu_PATH/package/recovery/Config.in"

endmenu
```

## configs/spacemit_k3_defconfig
```kconfig
BR2_riscv=y
BR2_riscv_custom=y
BR2_RISCV_ISA_RVM=y
BR2_RISCV_ISA_RVA=y
BR2_RISCV_ISA_RVF=y
BR2_RISCV_ISA_RVD=y
BR2_RISCV_ISA_RVC=y
BR2_TOOLCHAIN_EXTERNAL=y
BR2_TOOLCHAIN_EXTERNAL_DOWNLOAD=y
BR2_TOOLCHAIN_EXTERNAL_URL="http://archive.spacemit.com/toolchain/spacemit-toolchain-linux-glibc-x86_64-v1.2.2.tar.xz"
BR2_TOOLCHAIN_EXTERNAL_CUSTOM_PREFIX="$(ARCH)-unknown-linux-gnu"
BR2_TOOLCHAIN_EXTERNAL_HEADERS_6_12=y
BR2_TOOLCHAIN_EXTERNAL_CUSTOM_GLIBC=y
# BR2_TOOLCHAIN_EXTERNAL_INET_RPC is not set
BR2_TOOLCHAIN_EXTERNAL_CXX=y
BR2_TOOLCHAIN_EXTERNAL_FORTRAN=y
BR2_TOOLCHAIN_EXTERNAL_OPENMP=y
BR2_PRIMARY_SITE="http://archive.spacemit.com/buildroot/dl"
BR2_CCACHE=y
BR2_PACKAGE_OVERRIDE_FILE="$(TOPDIR)/../buildroot-ext/local.mk"
BR2_GLOBAL_PATCH_DIR="$(TOPDIR)/../buildroot-ext/patches/"
BR2_TARGET_GENERIC_HOSTNAME="K3-Buildroot"
BR2_ROOTFS_DEVICE_CREATION_DYNAMIC_EUDEV=y
BR2_TARGET_GENERIC_ROOT_PASSWD="bianbu"
# BR2_ENABLE_LOCALE_PURGE is not set
BR2_GENERATE_LOCALE="C en_US.UTF-8 zh_CN.UTF-8"
BR2_ROOTFS_OVERLAY="$(BR2_EXTERNAL_Bianbu_PATH)/board/spacemit/k3/target_overlay"
BR2_ROOTFS_POST_BUILD_SCRIPT="$(BR2_EXTERNAL_Bianbu_PATH)/board/spacemit/k3/post-build.sh"
BR2_ROOTFS_POST_IMAGE_SCRIPT="$(BR2_EXTERNAL_Bianbu_PATH)/board/spacemit/k3/prepare_img.sh"
BR2_ROOTFS_POST_SCRIPT_ARGS="$(BR2_LINUX_KERNEL_IMAGE_TARGET_NAME)"
BR2_LINUX_KERNEL=y
BR2_LINUX_KERNEL_CUSTOM_DIR=y
BR2_LINUX_KERNEL_CUSTOM_DIR_LOCATION="$(TOPDIR)/../bsp-src/linux-6.18"
BR2_LINUX_KERNEL_USE_CUSTOM_CONFIG=y
BR2_LINUX_KERNEL_CUSTOM_CONFIG_FILE="$(LINUX_OVERRIDE_SRCDIR)/arch/riscv/configs/k3_bianbu_defconfig"
BR2_LINUX_KERNEL_IMAGE_TARGET_CUSTOM=y
BR2_LINUX_KERNEL_IMAGE_TARGET_NAME="Image"
BR2_LINUX_KERNEL_IMAGE_NAME="Image"
BR2_LINUX_KERNEL_DTS_SUPPORT=y
BR2_LINUX_KERNEL_INTREE_DTS_NAME="spacemit/k3_fpga_1x1 spacemit/k3_evb spacemit/k3_deb1 spacemit/k3_com260 spacemit/k3_com260_kit_v02 spacemit/k3_dc_board spacemit/k3_gemini_c0 spacemit/k3_gemini_c1 spacemit/k3_evb2-1 spacemit/k3_evb2-2 spacemit/k3-pico-itx spacemit/k3_com260_ifx"
BR2_PACKAGE_LINUX_TOOLS_GPIO=y
BR2_PACKAGE_BUSYBOX_SHOW_OTHERS=y
BR2_PACKAGE_ALSA_UTILS=y
BR2_PACKAGE_ALSA_UTILS_AMIXER=y
BR2_PACKAGE_ALSA_UTILS_APLAY=y
BR2_PACKAGE_ALSA_UTILS_APLAYMIDI=y
BR2_PACKAGE_FFMPEG_ENABLE_SPACEMIT_MPP=y
BR2_PACKAGE_FFMPEG_GPL=y
BR2_PACKAGE_FFMPEG_NONFREE=y
BR2_PACKAGE_FFMPEG_FFPLAY=y
BR2_PACKAGE_FFMPEG_FFPROBE=y
BR2_PACKAGE_FFMPEG_POSTPROC=y
# BR2_PACKAGE_GST1_PLUGINS_BASE_PLUGIN_RAWPARSE is not set
BR2_PACKAGE_GST1_PLUGINS_BASE_PLUGIN_VIDEOTESTSRC=y
BR2_PACKAGE_GST1_PLUGINS_GOOD_PLUGIN_AUTODETECT=y
BR2_PACKAGE_GST1_PLUGINS_GOOD_PLUGIN_DEINTERLACE=y
BR2_PACKAGE_GST1_PLUGINS_GOOD_PLUGIN_V4L2=y
BR2_PACKAGE_GST1_PLUGINS_BAD=y
BR2_PACKAGE_GST1_PLUGINS_BAD_PLUGIN_VIDEOPARSERS=y
BR2_PACKAGE_GST1_LIBAV=y
BR2_PACKAGE_GST1_PYTHON=y
BR2_PACKAGE_GST1_RTSP_SERVER=y
BR2_PACKAGE_GZIP=y
BR2_PACKAGE_P7ZIP=y
BR2_PACKAGE_UNRAR=y
BR2_PACKAGE_UNZIP=y
BR2_PACKAGE_ZIP=y
BR2_PACKAGE_ZSTD=y
BR2_PACKAGE_DHRYSTONE=y
BR2_PACKAGE_FIO=y
BR2_PACKAGE_IOZONE=y
BR2_PACKAGE_LSOF=y
BR2_PACKAGE_MBW=y
BR2_PACKAGE_STRESS_NG=y
BR2_PACKAGE_GETTEXT=y
BR2_PACKAGE_GREP=y
BR2_PACKAGE_JQ=y
BR2_PACKAGE_SED=y
BR2_PACKAGE_TREE=y
BR2_PACKAGE_E2FSPROGS=y
BR2_PACKAGE_E2FSPROGS_RESIZE2FS=y
BR2_PACKAGE_EXFAT_UTILS=y
BR2_PACKAGE_EXFATPROGS=y
BR2_PACKAGE_MTD=y
BR2_PACKAGE_NFS_UTILS=y
BR2_PACKAGE_NTFS_3G=y
BR2_PACKAGE_NTFS_3G_NTFSPROGS=y
BR2_PACKAGE_XFSPROGS=y
BR2_PACKAGE_LIBERATION=y
BR2_PACKAGE_WQY_ZENHEI=y
BR2_PACKAGE_GLMARK2=y
BR2_PACKAGE_LIBGLVND=y
BR2_PACKAGE_MESA3D_GALLIUM_DRIVER_SWRAST=y
BR2_PACKAGE_MESA3D_GALLIUM_DRIVER_ZINK=y
BR2_PACKAGE_MESA3D_OPENGL_ES=y
BR2_PACKAGE_SDL2_KMSDRM=y
BR2_PACKAGE_SDL2_OPENGLES=y
BR2_PACKAGE_WESTON=y
BR2_PACKAGE_XORG7=y
BR2_PACKAGE_XWAYLAND=y
BR2_PACKAGE_CRYPTSETUP=y
# BR2_PACKAGE_EUDEV_ENABLE_HWDB is not set
BR2_PACKAGE_GPTFDISK=y
BR2_PACKAGE_MDADM=y
BR2_PACKAGE_MEMTESTER=y
BR2_PACKAGE_PCIUTILS=y
BR2_PACKAGE_SMARTMONTOOLS=y
BR2_PACKAGE_SYSSTAT=y
BR2_PACKAGE_PYTHON3=y
BR2_PACKAGE_PYTHON3_XZ=y
BR2_PACKAGE_PYTHON_PIP=y
BR2_PACKAGE_PYTHON_PYQT5_SIP=y
BR2_PACKAGE_PYTHON_PYYAML=y
BR2_PACKAGE_TINYALSA=y
BR2_PACKAGE_LZ4=y
BR2_PACKAGE_ZLIB_NG=y
BR2_PACKAGE_GNUTLS=y
BR2_PACKAGE_LIBNSS=y
BR2_PACKAGE_LIBOPENSSL_BIN=y
BR2_PACKAGE_LIBOPENSSL_ENGINES=y
BR2_PACKAGE_JASPER=y
BR2_PACKAGE_JPEG_TURBO=y
BR2_PACKAGE_LCMS2=y
BR2_PACKAGE_LIBDRM_INSTALL_TESTS=y
BR2_PACKAGE_OPENCV4=y
BR2_PACKAGE_OPENCV4_LIB_CALIB3D=y
BR2_PACKAGE_OPENCV4_LIB_HIGHGUI=y
BR2_PACKAGE_OPENCV4_LIB_PYTHON=y
BR2_PACKAGE_OPENCV4_WITH_FFMPEG=y
BR2_PACKAGE_OPENCV4_WITH_GSTREAMER1=y
BR2_PACKAGE_OPENCV4_WITH_JPEG=y
BR2_PACKAGE_OPENCV4_WITH_PNG=y
BR2_PACKAGE_OPENCV4_WITH_V4L=y
BR2_PACKAGE_LIBSOUP=y
BR2_PACKAGE_OPENMPI=y
BR2_PACKAGE_PCRE2_16=y
BR2_PACKAGE_SLANG=y
BR2_PACKAGE_UTF8PROC=y
BR2_PACKAGE_HAVEGED=y
BR2_PACKAGE_BLUEZ_TOOLS=y
BR2_PACKAGE_BLUEZ5_UTILS=y
BR2_PACKAGE_BLUEZ5_UTILS_OBEX=y
BR2_PACKAGE_BLUEZ5_UTILS_CLIENT=y
BR2_PACKAGE_BLUEZ5_UTILS_MONITOR=y
BR2_PACKAGE_BLUEZ5_UTILS_DEPRECATED=y
BR2_PACKAGE_BLUEZ5_UTILS_PLUGINS_AUDIO=y
# BR2_PACKAGE_BLUEZ5_UTILS_PLUGINS_NETWORK is not set
BR2_PACKAGE_BLUEZ5_UTILS_TOOLS_HID2HCI=y
BR2_PACKAGE_CAN_UTILS=y
BR2_PACKAGE_CONNMAN=y
BR2_PACKAGE_CONNMAN_WIFI=y
BR2_PACKAGE_CONNMAN_CLIENT=y
BR2_PACKAGE_DHCPCD=y
BR2_PACKAGE_ETHTOOL=y
BR2_PACKAGE_IPERF3=y
BR2_PACKAGE_IPROUTE2=y
BR2_PACKAGE_IPSET=y
BR2_PACKAGE_IPUTILS=y
BR2_PACKAGE_NET_TOOLS=y
BR2_PACKAGE_NTP=y
BR2_PACKAGE_OPENSSH=y
BR2_PACKAGE_RSYNC=y
BR2_PACKAGE_WHOIS=y
BR2_PACKAGE_WPA_SUPPLICANT_EAP=y
BR2_PACKAGE_WPA_SUPPLICANT_CLI=y
BR2_PACKAGE_BASH=y
BR2_PACKAGE_FILE=y
BR2_PACKAGE_ANDROID_TOOLS=y
BR2_PACKAGE_ANDROID_TOOLS_ADB=y
BR2_PACKAGE_ANDROID_TOOLS_ADBD=y
BR2_PACKAGE_FTOP=y
BR2_PACKAGE_GETENT=y
BR2_PACKAGE_HTOP=y
BR2_PACKAGE_IOTOP=y
BR2_PACKAGE_KEYUTILS=y
BR2_PACKAGE_KMOD_TOOLS=y
BR2_PACKAGE_SEATD_BUILTIN=y
BR2_PACKAGE_SEATD_DAEMON=y
BR2_PACKAGE_TAR=y
BR2_PACKAGE_UTIL_LINUX_BINARIES=y
BR2_PACKAGE_UTIL_LINUX_IRQTOP=y
BR2_PACKAGE_UTIL_LINUX_KILL=y
BR2_PACKAGE_UTIL_LINUX_MORE=y
BR2_PACKAGE_UTIL_LINUX_MOUNT=y
BR2_PACKAGE_NANO=y
BR2_PACKAGE_VIM=y
BR2_TARGET_ROOTFS_CPIO=y
BR2_TARGET_ROOTFS_CPIO_DRACUT=y
BR2_TARGET_ROOTFS_CPIO_DRACUT_MODULES="$(BR2_EXTERNAL_Bianbu_PATH)/board/spacemit/k3/dracut-modules"
BR2_TARGET_ROOTFS_CPIO_DRACUT_CONF_FILES="$(BR2_EXTERNAL_Bianbu_PATH)/board/spacemit/k3/dracut.conf"
BR2_TARGET_ROOTFS_CPIO_GZIP=y
BR2_TARGET_ROOTFS_EXT2=y
BR2_TARGET_ROOTFS_EXT2_4=y
BR2_TARGET_ROOTFS_EXT2_SIZE="1536M"
# BR2_TARGET_ROOTFS_TAR is not set
BR2_TARGET_OPENSBI=y
BR2_TARGET_OPENSBI_CUSTOM_VERSION=y
BR2_TARGET_OPENSBI_CUSTOM_VERSION_VALUE="0.9"
BR2_TARGET_OPENSBI_PLAT="generic"
# BR2_TARGET_OPENSBI_INSTALL_JUMP_IMG is not set
BR2_TARGET_OPENSBI_ADDITIONAL_VARIABLES="PLATFORM_DEFCONFIG=k3_defconfig"
BR2_TARGET_UBOOT=y
BR2_TARGET_UBOOT_BUILD_SYSTEM_KCONFIG=y
BR2_TARGET_UBOOT_CUSTOM_VERSION=y
BR2_TARGET_UBOOT_CUSTOM_VERSION_VALUE="2022.10"
BR2_TARGET_UBOOT_USE_CUSTOM_CONFIG=y
BR2_TARGET_UBOOT_CUSTOM_CONFIG_FILE="$(UBOOT_OVERRIDE_SRCDIR)/configs/k3_defconfig"
# BR2_TARGET_UBOOT_FORMAT_BIN is not set
BR2_TARGET_UBOOT_FORMAT_CUSTOM=y
BR2_TARGET_UBOOT_FORMAT_CUSTOM_NAME="u-boot.itb u-boot-env-default.bin"
BR2_TARGET_UBOOT_SPL=y
BR2_TARGET_UBOOT_SPL_NAME="FSBL.bin bootinfo_*.bin"
BR2_PACKAGE_HOST_CMAKE=y
BR2_PACKAGE_HOST_GENIMAGE=y
BR2_PACKAGE_HOST_JQ=y
BR2_PACKAGE_HOST_KMOD_GZ=y
BR2_PACKAGE_HOST_KMOD_ZSTD=y
BR2_PACKAGE_HOST_KMOD_XZ=y
BR2_PACKAGE_HOST_PYTHON_PYYAML=y
BR2_PACKAGE_HOST_UBOOT_TOOLS=y
BR2_PACKAGE_HOST_UBOOT_TOOLS_FIT_SUPPORT=y
BR2_PACKAGE_HOST_UBOOT_TOOLS_FIT_SIGNATURE_SUPPORT=y
BR2_PACKAGE_RFKILL=y
BR2_PACKAGE_MPP=y
BR2_PACKAGE_IMG_GPU_POWERVR=y
BR2_PACKAGE_IMG_GPU_POWERVR_OUTPUT_WL=y
BR2_PACKAGE_DRM_TEST=y
BR2_PACKAGE_V2D_TEST=y
BR2_PACKAGE_K3X_VPU_TEST=y
BR2_PACKAGE_GPU_TEST=y
BR2_PACKAGE_K3X_VPU_FIRMWARE=y
BR2_PACKAGE_K3X_CAM=y
# BR2_PACKAGE_K1X_CAM is not set
# BR2_PACKAGE_JETSON_UTILS is not set
BR2_PACKAGE_ESOS=y
```

## package/factorytest/Config.in
```kconfig
config BR2_PACKAGE_FACTORYTEST
	bool "factorytest"
	help
	  Product line factory test suite.

if BR2_PACKAGE_FACTORYTEST

choice
	prompt "Board type"
	default BR2_PACKAGE_FACTORYTEST_BOARD_K3_PICO_ITX

config BR2_PACKAGE_FACTORYTEST_BOARD_K3_PICO_ITX
	bool "k3-pico-itx"

config BR2_PACKAGE_FACTORYTEST_BOARD_K3_COM260
	bool "k3-com260"

config BR2_PACKAGE_FACTORYTEST_BOARD_K3_COM260_KIT
	bool "k3-com260-kit"

config BR2_PACKAGE_FACTORYTEST_BOARD_K3_COM260_IFX
	bool "k3-com260-ifx"

config BR2_PACKAGE_FACTORYTEST_BOARD_K3_SLT
	bool "k3-slt"

endchoice

config BR2_PACKAGE_FACTORYTEST_BOARD
	string
	default "k3-pico-itx"    if BR2_PACKAGE_FACTORYTEST_BOARD_K3_PICO_ITX
	default "k3-com260"      if BR2_PACKAGE_FACTORYTEST_BOARD_K3_COM260
	default "k3-com260-kit"  if BR2_PACKAGE_FACTORYTEST_BOARD_K3_COM260_KIT
	default "k3-com260-ifx"  if BR2_PACKAGE_FACTORYTEST_BOARD_K3_COM260_IFX
	default "k3-slt"         if BR2_PACKAGE_FACTORYTEST_BOARD_K3_SLT

endif
```

## package/k3x-cam/Config.in
```kconfig
config BR2_PACKAGE_K3X_CAM
	bool "k3x-cam"
	default y
	help
	  Spacemit k3x camera demo test
```
